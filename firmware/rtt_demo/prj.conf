## CMakeLists.txt
```
cmake_minimum_required(VERSION 3.20.0)
find_package(Zephyr REQUIRED HINTS $ENV{ZEPHYR_BASE})
project(rtt_demo)
target_sources(app PRIVATE src/main.c)
```

## prj.conf
```kconfig
# Telemetry over SEGGER RTT (non-intrusive: writes a RAM ring buffer, no halt).
# Route the console to RTT so printk() goes out the RTT up-channel.
CONFIG_USE_SEGGER_RTT=y
CONFIG_RTT_CONSOLE=y
CONFIG_CONSOLE=y
CONFIG_UART_CONSOLE=n
```

## src/main.c
```c
#include <zephyr/kernel.h>

/* Pushes telemetry over RTT every 250 ms, sleeping (WFI) in between — to test
 * that the host reads it non-intrusively even while the core sleeps. */
int main(void)
{
    uint32_t counter = 0;
    while (1) {
        printk("counter=%u\n", counter++);
        k_msleep(250);
    }
    return 0;
}
```
