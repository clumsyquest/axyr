## CMakeLists.txt
```
cmake_minimum_required(VERSION 3.20.0)

find_package(Zephyr REQUIRED HINTS $ENV{ZEPHYR_BASE})
project(live_demo)

target_sources(app PRIVATE src/main.c)
```

## prj.conf
```kconfig
# A running demo. One switch wires in all Axyr on-device support.
CONFIG_AXYR=y
```

## src/main.c
```c
#include <zephyr/kernel.h>

/* A running target. The Axyr on-device support (RTT telemetry, coredump,
 * thread analysis, context-switch trace) comes from CONFIG_AXYR — see
 * ../axyr. Here we just do work and expose a global the host can watch. */

volatile uint32_t axyr_counter = 0;

int main(void)
{
	printk("live_demo running\n");
	while (1) {
		axyr_counter++;
		printk("counter=%u\n", axyr_counter);
		k_msleep(250);
	}
	return 0;
}
```
